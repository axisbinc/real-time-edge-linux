// Copyright AxisB Inc 2024

#include "imx8mp-var-som-symphony.dts"

/* AVB HW timer*/
&gpt1 {
	compatible = "fsl,avb-gpt";
	timer-channel = <1>; /* Use output compare channel 1*/
	rec-channel = <1 0 1>; // capture channel, eth port, ENET TC id
	prescale = <1>;
	domain = <0>;

	clocks = <&clk IMX8MP_CLK_GPT1_ROOT>,
		 <&clk IMX8MP_CLK_GPT1_ROOT>,
		 <&clk IMX8MP_AUDIO_PLL1>;
	clock-names = "ipg", "per", "audio_pll";

	/* Make the GPT clk root derive from the audio PLL*/
	assigned-clocks = <&clk IMX8MP_CLK_GPT1>;
	assigned-clock-parents = <&clk IMX8MP_AUDIO_PLL1_OUT>;
	assigned-clock-rates = <0>;

	gpt1_capin1_sel = <&gpr 0x4 2>;

	status = "okay";
};
